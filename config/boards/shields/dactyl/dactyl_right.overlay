// dactyl_right.overlay

#include "dactyl.dtsi"

&default_transform {
    col-offset = <6>;
};

&kscan0 {
    col-gpios = <&pro_micro_d 2  GPIO_ACTIVE_HIGH>,
                <&pro_micro_d 3  GPIO_ACTIVE_HIGH>,
                <&pro_micro_d 4  GPIO_ACTIVE_HIGH>,
                <&pro_micro_d 5  GPIO_ACTIVE_HIGH>,
                <&pro_micro_d 8  GPIO_ACTIVE_HIGH>,
                <&pro_micro_d 9  GPIO_ACTIVE_HIGH>;
};
