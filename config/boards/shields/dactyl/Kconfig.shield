## config/boards/shields/dactyl/Kconfig.shield
```kconfig
# config SHIELD_DACTYL
#     bool

config SHIELD_DACTYL_LEFT
    def_bool $(shields_list_contains,dactyl_left)
#     select SHIELD_DACTYL

config SHIELD_DACTYL_RIGHT
    def_bool $(shields_list_contains,dactyl_right)
#     select SHIELD_DACTYL
```
